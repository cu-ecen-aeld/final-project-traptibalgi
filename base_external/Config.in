## base_external/Config.in
```kconfig
source "$BR2_EXTERNAL_project_base_PATH/package/aesd-opencv-cam/Config.in"
source "$BR2_EXTERNAL_project_base_PATH/package/aesd-server/Config.in"
```

## base_external/package/aesd-app/Config.in
```kconfig
config BR2_PACKAGE_AESD_APP
	bool "aesd-app"
	help
		Adds the tester and application code for the server
```
